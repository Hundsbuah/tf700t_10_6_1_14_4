## drivers/crypto/eds/Kconfig
```kconfig
config CRYPTO_EDS
	tristate "Encrypted Data Store"
   default m
	help
	  With EDS (Encrypted Data Store) you can store your files in the encrypted container to prevent unauthorized access to sensitive information. TrueCrypt(R), VeraCrypt(R), LUKS, CyberSafe(R) container files are supported. The program can operate in two modes: normal and mounted. 
```

## fs/exfat_nofuse/Kconfig
```kconfig
config EXFAT_NOFUSE
        tristate "samsungs exfat driver"
	help
	  Enables samsungs exfat driver
	  https://github.com/rxrz/exfat-nofuse
```
